## lib/ieee802154/Kconfig
```kconfig
# Copyright (c) 2016 Intel Corporation
# SPDX-License-Identifier: Apache-2.0

config IEEE802154_FRAME
	bool "IEEE 802.15.4 frame parsing support"
	help
	  Common frame parsing utilities for IEEE 802.15.4.
	  This is automatically selected by IEEE 802.15.4 drivers
	  and the L2 subsystem.
```
